## Documentation/devicetree/bindings/video/ti,tc3587xxbg.txt
```
TC3587xxbg based DPI panel
==========================

Required properties
- compatible: value should be one of the following:
		"ti,tc3587xxbg"; /* For 1920x1200 Panel on DRA7 EVM */

- reg: i2c slave address of the chip on the board

Required nodes:
- Video port for DPI input which the tc3587 converts to DSI output

Example:
-------
	/* LCD Bridge Chip for driving DPI-to-DSI video to the LCD Panel */
	tc3587xxbg: tc3587xxbg@0E {
	compatible = "ti,tc3587xxbg";
		reg = <0x0E>;
		enable-gpios = <&pcf_lcd_tc3587x 0 GPIO_ACTIVE_LOW>;  /* P0, MASTER_POWER_ENn */

		port@0 {
				tc_in: endpoint {
				remote-endpoint = <&dpi_out>;
			};
		};
	};
```

## Documentation/devicetree/bindings/video/ti,tlc59108_bl.txt
```
tlc59108bl bindings

Required properties:
  - compatible: "ti,tlc59108-bl"
  - reg: I2C slave address (u8)
  - enable-gpios: gpio signal to power on the tlc59108 backlight controller


Example:

        /* TLC chip for LCD panel power and backlight  */
       tlc59108bl: tlc59108bl@40 {
                compatible = "ti,tlc59108-bl";
                reg = <0x40>;
                enable-gpios = <&pcf_lcd 13 GPIO_ACTIVE_LOW>;  /* P15, CON_LCD_PWR_DN */
        };
```
